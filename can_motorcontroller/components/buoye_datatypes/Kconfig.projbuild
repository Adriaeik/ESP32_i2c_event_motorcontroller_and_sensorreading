## can_motorcontroller/components/buoye_datatypes/Kconfig.projbuild
```kconfig
menu "BUOYE STRUCTS Configuration"

    config USE_TROLL_DATA
        bool "Use extra structs for modbusdata"
        default y
        help
            /if you are using this component for modem, deselect this
    
    menu "Default Configuration"

    menu "buoye_config_t"

        config DEFAULT_TIME_TO_START_WORK
            int "Default current_time_to_start_work (epoch)"
            default 0

        config DEFAULT_TIME_TO_START_NEXT_WORK
            int "Default time_to_start_next_work (epoch)"
            default 0

        menu "sheared_config_t"

            config DEFAULT_PERIODIC_TIME_SEC
                int "Default periodic time (s)"
                default 300

            config DEFAULT_SERVICE_FLAG
                bool "Enable service flag by default"
                default n

            config DEFAULT_SERVICE_TIME
                int "Default service time (epoch)"
                default 0

            menu "poll_config_t"

                config DEFAULT_POLL_TYPE
                    int "Default poll type"
                    default 0

                config DEFAULT_TIMEOUT
                    int "Default timeout (s)"
                    default 60

                config DEFAULT_START_DEPTH
                    int "Default start depth (cm)"
                    default 0

                config DEFAULT_END_DEPTH
                    int "Default end depth (cm)"
                    default 600

                config DEFAULT_SAMPLE_COUNT
                    int "Default sample count"
                    default 3

                config DEFAULT_STATIC_POLL_PERIOD
                    int "Default poll period between static samples"
                    default 10

                config DEFAULT_STATIC_POINTS
                    string "Default points to measure in static mode"
                    default "10,25,67,90,43,62"


            endmenu # poll_config_t

        endmenu # sheared_config_t

    endmenu # buoye_config_t

    menu "sheared_status_t"

        config DEFAULT_BATTERY_LEVEL
            int "Default battery level (%)"
            default 100

        config DEFAULT_CLOCK_ERROR
            int "Default clock error (s)"
            default 0

        config DEFAULT_ESTIMATED_DEPTH
            int "Default estimated depth (cm)"
            default 0

        config DEFAULT_TIME_TO_START_CYCLE
            int "Default time to start cycle (epoch)"
            default 0

    endmenu # sheared_status_t

    endmenu # Default Configuration
endmenu
```

## can_motorcontroller/components/can_bus_manager/Kconfig.projbuild
```kconfig
menu "CAN Bus Manager Configuration"

    config CAN_TX_GPIO
        int "CAN TX GPIO Pin"
        default 25
        range 0 39
        help
            GPIO pin for CAN TX signal.
            
    config CAN_RX_GPIO
        int "CAN RX GPIO Pin"
        default 26
        range 0 39
        help
            GPIO pin for CAN RX signal.
            
    config CAN_BUS_BITRATE
        int "CAN Bus Bitrate (bps)"
        default 500000
        help
            CAN bus bitrate in bits per second.
            Common values: 125000, 250000, 500000, 1000000
            
    config CAN_BUS_TX_QUEUE_SIZE
        int "TX Queue Size"
        default 16
        range 4 64
        help
            Size of transmit queue for each priority level.
            
    config CAN_BUS_RX_QUEUE_SIZE
        int "RX Queue Size"  
        default 32
        range 8 128
        help
            Size of receive queue.
            
    config CAN_BUS_ENABLE_STATISTICS
        bool "Enable Bus Statistics"
        default y
        help
            Enable collection of bus statistics (messages sent/received, errors, etc.).
            
    config CAN_BUS_WATCHDOG_INTERVAL_MS
        int "Watchdog Interval (ms)"
        default 1000
        range 100 10000
        help
            Interval for bus health monitoring and statistics logging.
            
    config CAN_BUS_RECOVERY_DELAY_MS
        int "Bus Recovery Delay (ms)"
        default 500
        range 100 5000
        help
            Delay before attempting bus recovery after bus-off condition.
            
    config CAN_BUS_STARVATION_THRESHOLD
        int "Priority Starvation Threshold"
        default 10
        range 5 50
        help
            Number of higher priority messages before forcing lower priority message.
            
endmenu
```

## can_motorcontroller/components/can_motctrl/Kconfig.projbuild
```kconfig
menu "CAN Motor Controller Configuration"

    config CAN_MOTCTRL_DEFAULT_TIMEOUT_SEC
        int "Default Operation Timeout (seconds)"
        default 30
        range 10 1800
        help
            Default timeout for motor controller operations.
            
    config CAN_MOTCTRL_MIN_TIMEOUT_SEC
        int "Minimum Operation Timeout (seconds)"
        default 10
        range 5 60
        help
            Minimum allowed timeout for motor controller operations.
            
    config CAN_MOTCTRL_MAX_TIMEOUT_SEC
        int "Maximum Operation Timeout (seconds)"
        default 1800
        range 60 3600
        help
            Maximum allowed timeout for motor controller operations (30 minutes default).
            
    config CAN_MOTCTRL_FRAGMENT_BUFFER_SIZE
        int "Fragment Buffer Size (bytes)"
        default 1024
        range 256 4096
        help
            Size of buffer for assembling fragmented messages.
            
    config CAN_MOTCTRL_ENABLE_DEBUG
        bool "Enable Motor Controller Debug"
        default y
        help
            Enable debug features like message tracing and performance monitoring.
            
    config CAN_MOTCTRL_TRACE_BUFFER_SIZE
        int "Debug Trace Buffer Size (entries)"
        default 1000
        range 100 5000
        depends on CAN_MOTCTRL_ENABLE_DEBUG
        help
            Number of debug trace entries to keep in memory.
            
    config CAN_MOTCTRL_ERROR_BUFFER_SIZE
        int "Error Trace Buffer Size (entries)"
        default 100
        range 10 500
        depends on CAN_MOTCTRL_ENABLE_DEBUG
        help
            Number of error trace entries to keep in memory.
            
    config CAN_MOTCTRL_PERFORMANCE_WINDOW_MS
        int "Performance Monitoring Window (ms)"
        default 10000
        range 1000 60000
        depends on CAN_MOTCTRL_ENABLE_DEBUG
        help
            Time window for performance metrics calculation.
            
endmenu
```

## can_motorcontroller/components/motorcontroller_worker/Kconfig.projbuild
```kconfig
menu "BUOYE CAN-bus Wroker vinsj controller"
    config MOTCTRL_WORKER_ENABLE_DEEP_SLEEP
        bool "Enable deep sleep after work completion"
        default y

menu "Sensorar (input)"
    config GPIO_WINCH_HOME
        int "-X1:5 → GPIO for HOME"
        default 18
        range 0 39
        help 
            GPIO som skal koblast til endebrytaren som indikerer når vinsjen er heime (oppe).
            (NO) Dette er ein inngang som skal vere låg når vinsjen er heime.

    config GPIO_WINCH_TENSION
        int "-X1:6 → GPIO for TENSION"
        default 5
        range 0 39
        help
            GPIO som skal koblast til sensoren som gir høgt signal visst det er for stor last i wiren, 
            eller motorkontrolleren gir error signal.
            (NO) Dette er ein inngang som skal vere låg når vinsjen er under belastning.

    config GPIO_WINCH_AUTO
        int "-X1:7 → GPIO for AUTO"
        default 19
        range 0 39
        help
            GPIO som skal koblast til brytaren som indikerer at vinsjen skal gå i MANUEL-modus (Open), 
            eller AUTO-modus (CLOSED).
            (NO) Dette er ein inngang som skal vere høg når vinsjen er i AUTO-modus.

endmenu

menu "Aktuatorar (output)"
    config USE_WINCH_RUNNING_LAMP
        bool "Bruk LAMP for å indikere at vinsjen er i drift"
        default y
        help
            Dersom aktivert, vil LAMP bli slått på når vinsjen er i drift.
            Dersom deaktivert, vil LAMP ikkje bli brukt.
    
    config USE_AUTO_LAMP
        bool "Bruk AUTO_LAMP for å indikere at vinsjen er i AUTO-modus"
        default y   
        help
            Dersom aktivert, vil AUTO_LAMP bli slått på når vinsjen er i AUTO-modus.
            Dersom deaktivert, vil AUTO_LAMP ikkje bli brukt.
    
    config USE_ALARM_LAMP
        bool "Bruk ALARM_LAMP for å indikere at vinsjen er i Alarm tilstand"
        default y   
        help
            Dersom aktivert, vil ALARM_LAMP bli slått på når vinsjen er i Alarm tilstand.
            Dersom deaktivert, vil ALARM_LAMP ikkje bli brukt.
            
    config GPIO_WINCH_UP
        int "-X1:2 → GPIO for WINCH_UP"
        default 25
        range 0 39
        help
            GPIO som skal koblast til reléet som styrer vinsjen i oppover retning.
            (NO) Dette er ein utgang som skal vere høg når vinsjen skal heve lasten.

    config GPIO_WINCH_DOWN
        int "-X1:3 → GPIO for WINCH_DOWN"
        default 26
        range 0 39
        help
            GPIO som skal koblast til reléet som styrer vinsjen i nedover retning.
            (NO) Dette er ein utgang som skal vere høg når vinsjen skal senke lasten.
                    
    config GPIO_LAMP
        int "-X1:11 → GPIO for LAMP"
        default 16
        range 0 39
        depends on USE_WINCH_RUNNING_LAMP
        help
            GPIO som skal koblast til reléet som styrer Drifts lampe.
            Dette er ein utgang som skal vere høg når vinsjen er i drift.

    config GPIO_AUTO_LAMP
        int "-X1:12 → GPIO for AUTO_LAMP"
        default 2
        range 0 39
        depends on USE_AUTO_LAMP
        help
            GPIO som skal koblast til reléet som styrer AUTO lampe.
            Dette er ein utgang som skal vere høg når vinsjen er i AUTO-modus.

    config GPIO_ALARM_LAMP
        int "-X1:13 → GPIO for ALARM_LAMP"
        default 15
        range 0 39
        depends on USE_ALARM_LAMP
        help
            GPIO som skal koblast til reléet som styrer Alarm lampe.
            Dette er ein utgang som skal vere høg når vinsjen er i Alarm tilstand.
endmenu

endmenu
```

## i2c_motorcontroller/components/i2c_master_manager/Kconfig.projbuild
```kconfig
menu "I2C Master Manager Configuration"

    config I2C_MASTER_I2C_NUM
        int "I2C port number"
        range 0 1
        default 0
        help
            I2C port number for master communication.

    config I2C_MASTER_SCL_GPIO
        int "SCL GPIO number"
        range 0 48
        default 22
        help
            GPIO number for I2C SCL signal.

    config I2C_MASTER_SDA_GPIO  
        int "SDA GPIO number"
        range 0 48
        default 21
        help
            GPIO number for I2C SDA signal.

    config I2C_MASTER_CLK_SPEED
        int "I2C clock speed (Hz)"
        range 200000 1000000
        default 400000
        help
            I2C clock speed in Hz.

    menu "LSM6DS032TR Sensor"
        config LSM6DS032TR_DEVICE_ENABLED
            bool "Enable LSM6DS032TR IMU Sensor"
            default n
            help
                Enable LSM6DS032TR 6-axis IMU sensor support.

        config LSM6DS032TR_I2C_ADDR
            hex "LSM6DS032TR I2C address"
            range 0x6A 0x6B
            default 0x6A
            depends on LSM6DS032TR_DEVICE_ENABLED
            help
                I2C address of the LSM6DS032TR sensor (0x6A or 0x6B).

        config LSM6DS032TR_SAMPLE_RATE
            int "Sample rate (Hz)"
            range 12 6660
            default 104
            depends on LSM6DS032TR_DEVICE_ENABLED
            help
                Sample rate for accelerometer and gyroscope.
    endmenu

    menu "Custom I2C Devices"
        config CUSTOM_DEVICE_1_ENABLED
            bool "Enable Custom Device 1"
            default n
            help
                Enable custom I2C device 1.

        config CUSTOM_DEVICE_1_NAME
            string "Custom Device 1 Name"
            default "CUSTOM_DEV_1"
            depends on CUSTOM_DEVICE_1_ENABLED
            help
                Name identifier for custom device 1.

        config CUSTOM_DEVICE_1_ADDR
            hex "Custom Device 1 I2C address"
            range 0x08 0x77
            default 0x50
            depends on CUSTOM_DEVICE_1_ENABLED
            help
                I2C address of custom device 1.

        config CUSTOM_DEVICE_2_ENABLED
            bool "Enable Custom Device 2"
            default n
            help
                Enable custom I2C device 2.

        config CUSTOM_DEVICE_2_NAME
            string "Custom Device 2 Name"
            default "CUSTOM_DEV_2"
            depends on CUSTOM_DEVICE_2_ENABLED
            help
                Name identifier for custom device 2.

        config CUSTOM_DEVICE_2_ADDR
            hex "Custom Device 2 I2C address"
            range 0x08 0x77
            default 0x51
            depends on CUSTOM_DEVICE_2_ENABLED
            help
                I2C address of custom device 2.
    endmenu

endmenu
```

## i2c_motorcontroller/components/i2c_motorcontroller_master/Kconfig.projbuild
```kconfig
menu "Motor Controller Master Configuration"

    config MOTCTRL_I2C_ADDR
        hex "Motor controller I2C address"
        range 0x08 0x77
        default 0x42
        help
            I2C address of the motor controller slave device.

    config MOTCTRL_WAKEUP_PIN
        int "Motor controller wake-up pin"
        range -1 48
        default -1
        help
            GPIO pin to wake up motor controller. Set to -1 to disable.

endmenu
```

## i2c_motorcontroller/components/i2c_motorcontroller_slave/Kconfig.projbuild
```kconfig
menu "I2C Slave Motor Controller Configuration"

    config MOTCTRL_SLAVE_I2C_NUM
        int "I2C port number"
        range 0 1
        default 0
        help
            I2C port number for motor controller slave.

    config MOTCTRL_SLAVE_SCL_GPIO
        int "SCL GPIO number"
        range 0 48
        default 22
        help
            GPIO number for I2C SCL signal.

    config MOTCTRL_SLAVE_SDA_GPIO  
        int "SDA GPIO number"
        range 0 48
        default 21
        help
            GPIO number for I2C SDA signal.

    config MOTCTRL_SLAVE_ADDR
        hex "Motor controller slave I2C address"
        range 0x08 0x77
        default 0x42
        help
            I2C address of this motor controller slave device.

endmenu
```
